## config/west.yml
```yaml
manifest:
  defaults:
    remote: urob
    revision: main
    
  remotes:
    - name: urob
      url-base: https://github.com/urob

    - name: zmkfirmware
      url-base: https://github.com/zmkfirmware

    - name: carrefinho
      url-base: https://github.com/carrefinho

    - name: m165437
      url-base: https://github.com/m165437

    - name: badjeff
      url-base: https://github.com/badjeff

  projects:
    - name: zmk
      remote: zmkfirmware
      import: app/west.yml

    - name: zmk-adaptive-key
      path: modules/zmk/adaptive-key
    - name: zmk-auto-layer
      path: modules/zmk/auto-layer
    - name: zmk-helpers
      path: modules/zmk/helpers
    - name: zmk-leader-key
      path: modules/zmk/leader-key
    - name: zmk-tri-state
      path: modules/zmk/tri-state
    - name: zmk-unicode
      path: modules/zmk/unicode

    - name: prospector-zmk-module
      remote: carrefinho
      revision: feat/new-status-screens

    - name: nice-view-gem
      remote: m165437
      revision: main

    - name: zmk-pmw3610-driver
      remote: badjeff
      revision: main

  self:
    path: config
```
